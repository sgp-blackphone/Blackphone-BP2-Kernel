/* Copyright (c) 2014, The Linux Foundation. All rights reserved.
 *
 * This program is free software; you can redistribute it and/or modify
 * it under the terms of the GNU General Public License version 2 and
 * only version 2 as published by the Free Software Foundation.
 *
 * This program is distributed in the hope that it will be useful,
 * but WITHOUT ANY WARRANTY; without even the implied warranty of
 * MERCHANTABILITY or FITNESS FOR A PARTICULAR PURPOSE.  See the
 * GNU General Public License for more details.
 */

/*---------------------------------------------------------------------------
 * This file is autogenerated file using gcdb parser. Please do not edit it.
 * Update input XML file to add a new entry or update variable in this file
 * VERSION = "1.0"
 *---------------------------------------------------------------------------*/
&mdss_mdp {
	dsi_r63315_new_1080p_video: qcom,mdss_dsi_trulyr63315_new_1080p_video {
		qcom,mdss-dsi-panel-name = "truly r63315 new 1080p video mode dsi panel";
		qcom,mdss-dsi-panel-controller = <&mdss_dsi0>;
		qcom,mdss-dsi-panel-type = "dsi_video_mode";
		qcom,mdss-dsi-panel-destination = "display_1";
		qcom,mdss-dsi-panel-framerate = <60>;
		qcom,mdss-dsi-virtual-channel-id = <0>;
		qcom,mdss-dsi-stream = <0>;
		qcom,cont-splash-enabled;
		qcom,mdss-dsi-panel-width = <1080>;
		qcom,mdss-dsi-panel-height = <1920>;
		qcom,mdss-dsi-h-front-porch = <100>;
		qcom,mdss-dsi-h-back-porch = <64>;
		qcom,mdss-dsi-h-pulse-width = <16>;
		qcom,mdss-dsi-h-sync-skew = <0>;
		qcom,mdss-dsi-v-back-porch = <6>;
		qcom,mdss-dsi-v-front-porch = <4>;
		qcom,mdss-dsi-v-pulse-width = <2>;
		qcom,mdss-dsi-h-left-border = <0>;
		qcom,mdss-dsi-h-right-border = <0>;
		qcom,mdss-dsi-v-top-border = <0>;
		qcom,mdss-dsi-v-bottom-border = <0>;
		qcom,mdss-dsi-bpp = <24>;
		qcom,mdss-dsi-underflow-color = <0xff>;
		qcom,mdss-dsi-border-color = <0>;
		qcom,mdss-dsi-on-command = [29 01 00 00 00 00 02 B0 04			
                29 01 00 00 00 00 02 D6 01
                //29 01 00 00 00 00 0B E1 03 00 00 00 00 00 00 00 00 00
                //29 01 00 00 00 00 07 E2 01 00 00 00 00 00
                29 01 00 00 00 00 07 B3 14 00 00 00 00 00
                29 01 00 00 00 00 03 B4 0C 00
                29 01 00 00 00 00 03 B6 3A B3
                29 01 00 00 00 00 02 B7 00
                29 01 00 00 00 00 23 C1 04 60 00 C1 1C 94 FE 77 0C CA 3A 2D BD 97 DA 59 25 64 EE FF 42 86 00 00 00 00 00 00 42 13 14 2A 00 01
                29 01 00 00 00 00 08 C2 32 F7 80 08 08 00 00
                29 01 00 00 00 00 04 C3 00 00 00
                29 01 00 00 00 00 17 C4 70 00 00 00 00 00 00 00 00 00 03 00 00 00 00 00 00 00 00 00 00 03
                29 01 00 00 00 00 29 C6 C8 01 6C 01 6C 00 00 00 00 00 00 00 00 00 00 00 00 03 1D 08 C8 01 6C 01 6C 00 00 00 00 00 00 00 00 00 00 00 00 05 1C 08
                29 01 00 00 00 00 1F C7 01 15 1E 29 38 48 52 62 46 4D 58 62 69 6F 75 01 15 1E 29 38 48 52 62 46 4D 58 62 69 6F 75
                29 01 00 00 00 00 14 C8 00 00 FF 00 00 EC 00 00 EC 00 00 FC 00 00 FF 00 00 FC 0F
                29 01 00 00 00 00 21 CA 00 80 80 80 80 80 C0 80 08 20 80 80 0A 4A 37 A0 55 F8 0C 0C 20 10 3F 3F 00 40 10 10 3F 3F 3F 3F
                29 01 00 00 00 00 0A CB 9F FF FF F9 00 01 80 00 C0
                23 01 00 00 00 00 02 CC 14
                29 01 00 00 00 00 06 CF 00 00 C1 05 3F
                29 01 00 00 00 00 0B D0 11 81 BB 5C CA 44 19 19 04 00
                29 01 00 00 00 00 1B D1 20 00 00 04 08 0C 10 00 00 00 00 00 3C 04 20 00 00 04 08 0C 10 00 00 3C C6 F0
                29 01 00 00 00 00 1A D3 1B 33 BB BB B3 33 33 33 00 01 00 A0 C8 A0 00 60 60 33 3B 37 72 57 3D BF DD
                //29 01 00 00 00 00 08 D5 06 00 00 01 24 01 23
                29 01 00 00 00 00 03 DD 10 8C
                29 01 00 00 00 00 17 D7 84 E0 7F A8 CE 38 FC C1 18 E7 83 1F 3C 10 FA C3 0F 04 41 00 00 00            
                05 01 00 00 23 00 02 29 00
                05 01 00 00 78 00 02 11 00];

		qcom,mdss-dsi-off-command = [05 01 00 00 02 00 02 28 00
				 05 01 00 00 79 00 02 10 00];
		qcom,mdss-dsi-on-command-state = "dsi_lp_mode";
		qcom,mdss-dsi-off-command-state = "dsi_hs_mode";
		qcom,mdss-dsi-h-sync-pulse = <1>;
		qcom,mdss-dsi-traffic-mode = "burst_mode";
		qcom,mdss-dsi-lane-map = "lane_map_0123";
		qcom,mdss-dsi-bllp-eof-power-mode;
		qcom,mdss-dsi-bllp-power-mode;
		qcom,mdss-dsi-lane-0-state;
		qcom,mdss-dsi-lane-1-state;
		qcom,mdss-dsi-lane-2-state;
		qcom,mdss-dsi-lane-3-state;
		qcom,mdss-dsi-panel-timings = [E7 36 24 00 66 6A 2A 3A 2D 03 04 00];
		qcom,mdss-dsi-t-clk-post = <0x04>;
		qcom,mdss-dsi-t-clk-pre = <0x1b>;
		qcom,mdss-dsi-bl-min-level = <1>;
		qcom,mdss-dsi-bl-max-level = <4095>;
       	qcom,mdss-dsi-bl-pmic-control-type = "bl_ctrl_pwm";
       	qcom,mdss-dsi-bl-pmic-pwm-frequency = <255>;
       	qcom,mdss-dsi-bl-pmic-bank-select = <0>;
       	qcom,mdss-dsi-pwm-gpio = <&pm8916_mpps 4 0>;
		qcom,mdss-dsi-power-ic-en-gpio = <&msm_gpio 49 0>;
		qcom,mdss-dsi-dma-trigger = "trigger_sw";
		qcom,mdss-dsi-mdp-trigger = "none";
		qcom,mdss-dsi-reset-sequence = <1 20>, <0 10>, <1 20>;
		qcom,mdss-pan-physical-width-dimension = <68>;
		qcom,mdss-pan-physical-height-dimension = <121>;
	};
};
