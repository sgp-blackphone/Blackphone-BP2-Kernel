/* Copyright (c) 2014, The Linux Foundation. All rights reserved.
 *
 * This program is free software; you can redistribute it and/or modify
 * it under the terms of the GNU General Public License version 2 and
 * only version 2 as published by the Free Software Foundation.
 *
 * This program is distributed in the hope that it will be useful,
 * but WITHOUT ANY WARRANTY; without even the implied warranty of
 * MERCHANTABILITY or FITNESS FOR A PARTICULAR PURPOSE.  See the
 * GNU General Public License for more details.
 */

&mdss_mdp {
	dsi_yushun_nt35596_1080p_video: qcom,mdss_dsi_yushunnt35596_1080p_video {
		qcom,mdss-dsi-panel-name = "yushun nt35596 1080p video mode dsi panel";
		qcom,mdss-dsi-panel-controller = <&mdss_dsi0>;
		qcom,mdss-dsi-panel-type = "dsi_video_mode";
		qcom,mdss-dsi-panel-destination = "display_1";
		qcom,mdss-dsi-panel-framerate = <60>;
		qcom,mdss-dsi-virtual-channel-id = <0>;
		qcom,mdss-dsi-stream = <0>;
		qcom,cont-splash-enabled;
		qcom,mdss-dsi-panel-width = <1080>;
		qcom,mdss-dsi-panel-height = <1920>;
		qcom,mdss-dsi-h-front-porch = <128>;
		qcom,mdss-dsi-h-back-porch = <64>;
		qcom,mdss-dsi-h-pulse-width = <16>;
		qcom,mdss-dsi-h-sync-skew = <0>;
		qcom,mdss-dsi-v-back-porch = <6>;
		qcom,mdss-dsi-v-front-porch = <6>;
		qcom,mdss-dsi-v-pulse-width = <2>;
		qcom,mdss-dsi-h-left-border = <0>;
		qcom,mdss-dsi-h-right-border = <0>;
		qcom,mdss-dsi-v-top-border = <0>;
		qcom,mdss-dsi-v-bottom-border = <0>;
		qcom,mdss-dsi-bpp = <24>;
		qcom,mdss-dsi-underflow-color = <0xff>;
		qcom,mdss-dsi-border-color = <0>;
		qcom,mdss-dsi-on-command = [
			15 00 00 00 00 00 02 FF EE
			15 00 00 00 00 00 02 FB 01
			15 00 00 00 0A 00 02 18 40
			15 00 00 00 14 00 02 18 00
			15 00 00 00 00 00 02 FF 05
			15 00 00 00 00 00 02 C5 31
			15 00 00 00 20 00 02 FB 01
			15 00 00 00 00 00 02 FF EE
			15 00 00 00 00 00 02 24 4F
			15 00 00 00 00 00 02 38 C8
			15 00 00 00 00 00 02 39 27
			15 00 00 00 00 00 02 1E 77
			15 00 00 00 00 00 02 1D 0F
			15 00 00 00 00 00 02 7E 71
			15 00 00 00 00 00 02 7C 31
			15 00 00 00 00 00 02 FB 01
			15 00 00 00 00 00 02 FF 01
			15 00 00 00 00 00 02 00 01
			15 00 00 00 00 00 02 01 55
			15 00 00 00 00 00 02 02 40
			15 00 00 00 00 00 02 05 50
			15 00 00 00 00 00 02 06 4A
			15 00 00 00 00 00 02 07 29
			15 00 00 00 00 00 02 08 0C
			15 00 00 00 00 00 02 0B 87
			15 00 00 00 00 00 02 0C 87
			15 00 00 00 00 00 02 0E B0
			15 00 00 00 00 00 02 0F B3
			15 00 00 00 00 00 02 11 10
			15 00 00 00 00 00 02 12 10
			15 00 00 00 00 00 02 13 03
			15 00 00 00 00 00 02 14 4A
			15 00 00 00 00 00 02 15 12
			15 00 00 00 00 00 02 16 12
			15 00 00 00 00 00 02 18 00
			15 00 00 00 00 00 02 19 77
			15 00 00 00 00 00 02 1A 55
			15 00 00 00 00 00 02 1B 13
			15 00 00 00 00 00 02 1C 00
			15 00 00 00 00 00 02 1D 00
			15 00 00 00 00 00 02 1E 00
			15 00 00 00 00 00 02 1F 00
			15 00 00 00 00 00 02 58 82
			15 00 00 00 00 00 02 59 02
			15 00 00 00 00 00 02 5A 02
			15 00 00 00 00 00 02 5B 02
			15 00 00 00 00 00 02 5C 82
			15 00 00 00 00 00 02 5D 82
			15 00 00 00 00 00 02 5E 02
			15 00 00 00 00 00 02 5F 02
			15 00 00 00 00 00 02 72 31
			15 00 00 00 00 00 02 FB 01
			15 00 00 00 00 00 02 FF 05
			15 00 00 00 00 00 02 00 01
			15 00 00 00 00 00 02 01 0B
			15 00 00 00 00 00 02 02 0C
			15 00 00 00 00 00 02 03 09
			15 00 00 00 00 00 02 04 0A
			15 00 00 00 00 00 02 05 00
			15 00 00 00 00 00 02 06 0F
			15 00 00 00 00 00 02 07 10
			15 00 00 00 00 00 02 08 00
			15 00 00 00 00 00 02 09 00
			15 00 00 00 00 00 02 0A 00
			15 00 00 00 00 00 02 0B 00
			15 00 00 00 00 00 02 0C 00
			15 00 00 00 00 00 02 0D 13
			15 00 00 00 00 00 02 0E 15
			15 00 00 00 00 00 02 0F 17
			15 00 00 00 00 00 02 10 01
			15 00 00 00 00 00 02 11 0B
			15 00 00 00 00 00 02 12 0C
			15 00 00 00 00 00 02 13 09
			15 00 00 00 00 00 02 14 0A
			15 00 00 00 00 00 02 15 00
			15 00 00 00 00 00 02 16 0F
			15 00 00 00 00 00 02 17 10
			15 00 00 00 00 00 02 18 00
			15 00 00 00 00 00 02 19 00
			15 00 00 00 00 00 02 1A 00
			15 00 00 00 00 00 02 1B 00
			15 00 00 00 00 00 02 1C 00
			15 00 00 00 00 00 02 1D 13
			15 00 00 00 00 00 02 1E 15
			15 00 00 00 00 00 02 1F 17
			15 00 00 00 00 00 02 20 00
			15 00 00 00 00 00 02 21 03
			15 00 00 00 00 00 02 22 01
			15 00 00 00 00 00 02 23 40
			15 00 00 00 00 00 02 24 40
			15 00 00 00 00 00 02 25 ED
			15 00 00 00 00 00 02 29 58
			15 00 00 00 00 00 02 2A 12
			15 00 00 00 00 00 02 2B 01
			15 00 00 00 00 00 02 4B 04
			15 00 00 00 00 00 02 4C 12
			15 00 00 00 00 00 02 4D 02
			15 00 00 00 00 00 02 4E 20
			15 00 00 00 00 00 02 4F 20
			15 00 00 00 00 00 02 50 02
			15 00 00 00 00 00 02 51 61
			15 00 00 00 00 00 02 52 01
			15 00 00 00 00 00 02 53 63
			15 00 00 00 00 00 02 54 75
			15 00 00 00 00 00 02 55 ED
			15 00 00 00 00 00 02 5B 00
			15 00 00 00 00 00 02 5C 00
			15 00 00 00 00 00 02 5F 15
			15 00 00 00 00 00 02 60 75
			15 00 00 00 00 00 02 63 00
			15 00 00 00 00 00 02 64 00
			15 00 00 00 00 00 02 67 00
			15 00 00 00 00 00 02 68 04
			15 00 00 00 00 00 02 6C 40
			15 00 00 00 00 00 02 7A 80
			15 00 00 00 00 00 02 7B A3
			15 00 00 00 00 00 02 7C D8
			15 00 00 00 00 00 02 7D 60
			15 00 00 00 00 00 02 7F 15
			15 00 00 00 00 00 02 80 00
			15 00 00 00 00 00 02 83 00
			15 00 00 00 00 00 02 93 08
			15 00 00 00 00 00 02 94 0A
			15 00 00 00 00 00 02 8A 00
			15 00 00 00 00 00 02 9B 0F
			15 00 00 00 00 00 02 FB 01
			15 00 00 00 00 00 02 FF 01
            15 00 00 00 00 00 02 FF 01
            15 00 00 00 00 00 02 75 00
            15 00 00 00 00 00 02 76 D3
            15 00 00 00 00 00 02 77 00
            15 00 00 00 00 00 02 78 D9
            15 00 00 00 00 00 02 79 00
            15 00 00 00 00 00 02 7A E5
            15 00 00 00 00 00 02 7B 00
            15 00 00 00 00 00 02 7C F0
            15 00 00 00 00 00 02 7D 00
            15 00 00 00 00 00 02 7E FC
            15 00 00 00 00 00 02 7F 01
            15 00 00 00 00 00 02 80 05
            15 00 00 00 00 00 02 81 01
            15 00 00 00 00 00 02 82 0F
            15 00 00 00 00 00 02 83 01
            15 00 00 00 00 00 02 84 18
            15 00 00 00 00 00 02 85 01
            15 00 00 00 00 00 02 86 20
            15 00 00 00 00 00 02 87 01
            15 00 00 00 00 00 02 88 40
            15 00 00 00 00 00 02 89 01
            15 00 00 00 00 00 02 8A 5A
            15 00 00 00 00 00 02 8B 01
            15 00 00 00 00 00 02 8C 89
            15 00 00 00 00 00 02 8D 01
            15 00 00 00 00 00 02 8E AF
            15 00 00 00 00 00 02 8F 01
            15 00 00 00 00 00 02 90 F1
            15 00 00 00 00 00 02 91 02
            15 00 00 00 00 00 02 92 25
            15 00 00 00 00 00 02 93 02
            15 00 00 00 00 00 02 94 26
            15 00 00 00 00 00 02 95 02
            15 00 00 00 00 00 02 96 57
            15 00 00 00 00 00 02 97 02
            15 00 00 00 00 00 02 98 8D
            15 00 00 00 00 00 02 99 02
            15 00 00 00 00 00 02 9A B0
            15 00 00 00 00 00 02 9B 02
            15 00 00 00 00 00 02 9C E4
            15 00 00 00 00 00 02 9D 03
            15 00 00 00 00 00 02 9E 0B
            15 00 00 00 00 00 02 9F 03
            15 00 00 00 00 00 02 A0 3D
            15 00 00 00 00 00 02 A2 03
            15 00 00 00 00 00 02 A3 43
            15 00 00 00 00 00 02 A4 03
            15 00 00 00 00 00 02 A5 4E
            15 00 00 00 00 00 02 A6 03
            15 00 00 00 00 00 02 A7 60
            15 00 00 00 00 00 02 A9 03
            15 00 00 00 00 00 02 AA 77
            15 00 00 00 00 00 02 AB 03
            15 00 00 00 00 00 02 AC 96
            15 00 00 00 00 00 02 AD 03
            15 00 00 00 00 00 02 AE B8
            15 00 00 00 00 00 02 AF 03
            15 00 00 00 00 00 02 B0 CD
            15 00 00 00 00 00 02 B1 03
            15 00 00 00 00 00 02 B2 D0
            15 00 00 00 00 00 02 B3 00
            15 00 00 00 00 00 02 B4 D3
            15 00 00 00 00 00 02 B5 00
            15 00 00 00 00 00 02 B6 D9
            15 00 00 00 00 00 02 B7 00
            15 00 00 00 00 00 02 B8 E5
            15 00 00 00 00 00 02 B9 00
            15 00 00 00 00 00 02 BA F0
            15 00 00 00 00 00 02 BB 00
            15 00 00 00 00 00 02 BC FC
            15 00 00 00 00 00 02 BD 01
            15 00 00 00 00 00 02 BE 05
            15 00 00 00 00 00 02 BF 01
            15 00 00 00 00 00 02 C0 0F
            15 00 00 00 00 00 02 C1 01
            15 00 00 00 00 00 02 C2 18
            15 00 00 00 00 00 02 C3 01
            15 00 00 00 00 00 02 C4 20
            15 00 00 00 00 00 02 C5 01
            15 00 00 00 00 00 02 C6 40
            15 00 00 00 00 00 02 C7 01
            15 00 00 00 00 00 02 C8 5A
            15 00 00 00 00 00 02 C9 01
            15 00 00 00 00 00 02 CA 89
            15 00 00 00 00 00 02 CB 01
            15 00 00 00 00 00 02 CC AF
            15 00 00 00 00 00 02 CD 01
            15 00 00 00 00 00 02 CE F1
            15 00 00 00 00 00 02 CF 02
            15 00 00 00 00 00 02 D0 25
            15 00 00 00 00 00 02 D1 02
            15 00 00 00 00 00 02 D2 26
            15 00 00 00 00 00 02 D3 02
            15 00 00 00 00 00 02 D4 57
            15 00 00 00 00 00 02 D5 02
            15 00 00 00 00 00 02 D6 8D
            15 00 00 00 00 00 02 D7 02
            15 00 00 00 00 00 02 D8 B0
            15 00 00 00 00 00 02 D9 02
            15 00 00 00 00 00 02 DA E4
            15 00 00 00 00 00 02 DB 03
            15 00 00 00 00 00 02 DC 0B
            15 00 00 00 00 00 02 DD 03
            15 00 00 00 00 00 02 DE 3D
            15 00 00 00 00 00 02 DF 03
            15 00 00 00 00 00 02 E0 43
            15 00 00 00 00 00 02 E1 03
            15 00 00 00 00 00 02 E2 4E
            15 00 00 00 00 00 02 E3 03
            15 00 00 00 00 00 02 E4 60
            15 00 00 00 00 00 02 E5 03
            15 00 00 00 00 00 02 E6 77
            15 00 00 00 00 00 02 E7 03
            15 00 00 00 00 00 02 E8 96
            15 00 00 00 00 00 02 E9 03
            15 00 00 00 00 00 02 EA B8
            15 00 00 00 00 00 02 EB 03
            15 00 00 00 00 00 02 EC CD
            15 00 00 00 00 00 02 ED 03
            15 00 00 00 00 00 02 EE D0
            15 00 00 00 00 00 02 EF 00
            15 00 00 00 00 00 02 F0 01
            15 00 00 00 00 00 02 F1 00
            15 00 00 00 00 00 02 F2 18
            15 00 00 00 00 00 02 F3 00
            15 00 00 00 00 00 02 F4 3A
            15 00 00 00 00 00 02 F5 00
            15 00 00 00 00 00 02 F6 54
            15 00 00 00 00 00 02 F7 00
            15 00 00 00 00 00 02 F8 6D
            15 00 00 00 00 00 02 F9 00
            15 00 00 00 00 00 02 FA 80
            15 00 00 00 00 00 02 FF 02
            15 00 00 00 00 00 02 00 00
            15 00 00 00 00 00 02 01 93
            15 00 00 00 00 00 02 02 00
            15 00 00 00 00 00 02 03 A4
            15 00 00 00 00 00 02 04 00
            15 00 00 00 00 00 02 05 B2
            15 00 00 00 00 00 02 06 00
            15 00 00 00 00 00 02 07 E7
            15 00 00 00 00 00 02 08 01
            15 00 00 00 00 00 02 09 0F
            15 00 00 00 00 00 02 0A 01
            15 00 00 00 00 00 02 0B 4F
            15 00 00 00 00 00 02 0C 01
            15 00 00 00 00 00 02 0D 81
            15 00 00 00 00 00 02 0E 01
            15 00 00 00 00 00 02 0F D2
            15 00 00 00 00 00 02 10 02
            15 00 00 00 00 00 02 11 0F
            15 00 00 00 00 00 02 12 02
            15 00 00 00 00 00 02 13 10
            15 00 00 00 00 00 02 14 02
            15 00 00 00 00 00 02 15 46
            15 00 00 00 00 00 02 16 02
            15 00 00 00 00 00 02 17 7F
            15 00 00 00 00 00 02 18 02
            15 00 00 00 00 00 02 19 A3
            15 00 00 00 00 00 02 1A 02
            15 00 00 00 00 00 02 1B D6
            15 00 00 00 00 00 02 1C 02
            15 00 00 00 00 00 02 1D FD
            15 00 00 00 00 00 02 1E 03
            15 00 00 00 00 00 02 1F 2B
            15 00 00 00 00 00 02 20 03
            15 00 00 00 00 00 02 21 30
            15 00 00 00 00 00 02 22 03
            15 00 00 00 00 00 02 23 3C
            15 00 00 00 00 00 02 24 03
            15 00 00 00 00 00 02 25 52
            15 00 00 00 00 00 02 26 03
            15 00 00 00 00 00 02 27 72
            15 00 00 00 00 00 02 28 03
            15 00 00 00 00 00 02 29 92
            15 00 00 00 00 00 02 2A 03
            15 00 00 00 00 00 02 2B B6
            15 00 00 00 00 00 02 2D 03
            15 00 00 00 00 00 02 2F CD
            15 00 00 00 00 00 02 30 03
            15 00 00 00 00 00 02 31 D0
            15 00 00 00 00 00 02 32 00
            15 00 00 00 00 00 02 33 01
            15 00 00 00 00 00 02 34 00
            15 00 00 00 00 00 02 35 18
            15 00 00 00 00 00 02 36 00
            15 00 00 00 00 00 02 37 3A
            15 00 00 00 00 00 02 38 00
            15 00 00 00 00 00 02 39 54
            15 00 00 00 00 00 02 3A 00
            15 00 00 00 00 00 02 3B 6D
            15 00 00 00 00 00 02 3D 00
            15 00 00 00 00 00 02 3F 80
            15 00 00 00 00 00 02 40 00
            15 00 00 00 00 00 02 41 93
            15 00 00 00 00 00 02 42 00
            15 00 00 00 00 00 02 43 A4
            15 00 00 00 00 00 02 44 00
            15 00 00 00 00 00 02 45 B2
            15 00 00 00 00 00 02 46 00
            15 00 00 00 00 00 02 47 E7
            15 00 00 00 00 00 02 48 01
            15 00 00 00 00 00 02 49 0F
            15 00 00 00 00 00 02 4A 01
            15 00 00 00 00 00 02 4B 4F
            15 00 00 00 00 00 02 4C 01
            15 00 00 00 00 00 02 4D 81
            15 00 00 00 00 00 02 4E 01
            15 00 00 00 00 00 02 4F D2
            15 00 00 00 00 00 02 50 02
            15 00 00 00 00 00 02 51 0F
            15 00 00 00 00 00 02 52 02
            15 00 00 00 00 00 02 53 10
            15 00 00 00 00 00 02 54 02
            15 00 00 00 00 00 02 55 46
            15 00 00 00 00 00 02 56 02
            15 00 00 00 00 00 02 58 7F
            15 00 00 00 00 00 02 59 02
            15 00 00 00 00 00 02 5A A3
            15 00 00 00 00 00 02 5B 02
            15 00 00 00 00 00 02 5C D6
            15 00 00 00 00 00 02 5D 02
            15 00 00 00 00 00 02 5E FD
            15 00 00 00 00 00 02 5F 03
            15 00 00 00 00 00 02 60 2B
            15 00 00 00 00 00 02 61 03
            15 00 00 00 00 00 02 62 30
            15 00 00 00 00 00 02 63 03
            15 00 00 00 00 00 02 64 3C
            15 00 00 00 00 00 02 65 03
            15 00 00 00 00 00 02 66 52
            15 00 00 00 00 00 02 67 03
            15 00 00 00 00 00 02 68 72
            15 00 00 00 00 00 02 69 03
            15 00 00 00 00 00 02 6A 92
            15 00 00 00 00 00 02 6B 03
            15 00 00 00 00 00 02 6C B6
            15 00 00 00 00 00 02 6D 03
            15 00 00 00 00 00 02 6E CD
            15 00 00 00 00 00 02 6F 03
            15 00 00 00 00 00 02 70 D0
            15 00 00 00 00 00 02 71 00
            15 00 00 00 00 00 02 72 CE
            15 00 00 00 00 00 02 73 00
            15 00 00 00 00 00 02 74 D4
            15 00 00 00 00 00 02 75 00
            15 00 00 00 00 00 02 76 DF
            15 00 00 00 00 00 02 77 00
            15 00 00 00 00 00 02 78 E9
            15 00 00 00 00 00 02 79 00
            15 00 00 00 00 00 02 7A F4
            15 00 00 00 00 00 02 7B 00
            15 00 00 00 00 00 02 7C FD
            15 00 00 00 00 00 02 7D 01
            15 00 00 00 00 00 02 7E 07
            15 00 00 00 00 00 02 7F 01
            15 00 00 00 00 00 02 80 10
            15 00 00 00 00 00 02 81 01
            15 00 00 00 00 00 02 82 18
            15 00 00 00 00 00 02 83 01
            15 00 00 00 00 00 02 84 38
            15 00 00 00 00 00 02 85 01
            15 00 00 00 00 00 02 86 53
            15 00 00 00 00 00 02 87 01
            15 00 00 00 00 00 02 88 82
            15 00 00 00 00 00 02 89 01
            15 00 00 00 00 00 02 8A A9
            15 00 00 00 00 00 02 8B 01
            15 00 00 00 00 00 02 8C EC
            15 00 00 00 00 00 02 8D 02
            15 00 00 00 00 00 02 8E 21
            15 00 00 00 00 00 02 8F 02
            15 00 00 00 00 00 02 90 22
            15 00 00 00 00 00 02 91 02
            15 00 00 00 00 00 02 92 54
            15 00 00 00 00 00 02 93 02
            15 00 00 00 00 00 02 94 8B
            15 00 00 00 00 00 02 95 02
            15 00 00 00 00 00 02 96 B0
            15 00 00 00 00 00 02 97 02
            15 00 00 00 00 00 02 98 E8
            15 00 00 00 00 00 02 99 03
            15 00 00 00 00 00 02 9A 1A
            15 00 00 00 00 00 02 9B 03
            15 00 00 00 00 00 02 9C 8C
            15 00 00 00 00 00 02 9D 03
            15 00 00 00 00 00 02 9E C3
            15 00 00 00 00 00 02 9F 03
            15 00 00 00 00 00 02 A0 CA
            15 00 00 00 00 00 02 A2 03
            15 00 00 00 00 00 02 A3 CB
            15 00 00 00 00 00 02 A4 03
            15 00 00 00 00 00 02 A5 CC
            15 00 00 00 00 00 02 A6 03
            15 00 00 00 00 00 02 A7 CD
            15 00 00 00 00 00 02 A9 03
            15 00 00 00 00 00 02 AA CE
            15 00 00 00 00 00 02 AB 03
            15 00 00 00 00 00 02 AC CF
            15 00 00 00 00 00 02 AD 03
            15 00 00 00 00 00 02 AE D0
            15 00 00 00 00 00 02 AF 00
            15 00 00 00 00 00 02 B0 CE
            15 00 00 00 00 00 02 B1 00
            15 00 00 00 00 00 02 B2 D4
            15 00 00 00 00 00 02 B3 00
            15 00 00 00 00 00 02 B4 DF
            15 00 00 00 00 00 02 B5 00
            15 00 00 00 00 00 02 B6 E9
            15 00 00 00 00 00 02 B7 00
            15 00 00 00 00 00 02 B8 F4
            15 00 00 00 00 00 02 B9 00
            15 00 00 00 00 00 02 BA FD
            15 00 00 00 00 00 02 BB 01
            15 00 00 00 00 00 02 BC 07
            15 00 00 00 00 00 02 BD 01
            15 00 00 00 00 00 02 BE 10
            15 00 00 00 00 00 02 BF 01
            15 00 00 00 00 00 02 C0 18
            15 00 00 00 00 00 02 C1 01
            15 00 00 00 00 00 02 C2 38
            15 00 00 00 00 00 02 C3 01
            15 00 00 00 00 00 02 C4 53
            15 00 00 00 00 00 02 C5 01
            15 00 00 00 00 00 02 C6 82
            15 00 00 00 00 00 02 C7 01
            15 00 00 00 00 00 02 C8 A9
            15 00 00 00 00 00 02 C9 01
            15 00 00 00 00 00 02 CA EC
            15 00 00 00 00 00 02 CB 02
            15 00 00 00 00 00 02 CC 21
            15 00 00 00 00 00 02 CD 02
            15 00 00 00 00 00 02 CE 22
            15 00 00 00 00 00 02 CF 02
            15 00 00 00 00 00 02 D0 54
            15 00 00 00 00 00 02 D1 02
            15 00 00 00 00 00 02 D2 8B
            15 00 00 00 00 00 02 D3 02
            15 00 00 00 00 00 02 D4 B0
            15 00 00 00 00 00 02 D5 02
            15 00 00 00 00 00 02 D6 E8
            15 00 00 00 00 00 02 D7 03
            15 00 00 00 00 00 02 D8 1A
            15 00 00 00 00 00 02 D9 03
            15 00 00 00 00 00 02 DA 8C
            15 00 00 00 00 00 02 DB 03
            15 00 00 00 00 00 02 DC C3
            15 00 00 00 00 00 02 DD 03
            15 00 00 00 00 00 02 DE CA
            15 00 00 00 00 00 02 DF 03
            15 00 00 00 00 00 02 E0 CB
            15 00 00 00 00 00 02 E1 03
            15 00 00 00 00 00 02 E2 CC
            15 00 00 00 00 00 02 E3 03
            15 00 00 00 00 00 02 E4 CD
            15 00 00 00 00 00 02 E5 03
            15 00 00 00 00 00 02 E6 CE
            15 00 00 00 00 00 02 E7 03
            15 00 00 00 00 00 02 E8 CF
            15 00 00 00 00 00 02 E9 03
            15 00 00 00 00 00 02 EA D0
			15 00 00 00 00 00 02 FB 01
			15 00 00 00 00 00 02 FF 00
			15 00 00 00 00 00 02 D3 08
			15 00 00 00 00 00 02 D4 06
			15 01 00 00 00 00 02 35 00
			15 01 00 00 78 00 02 11 00
			15 01 00 00 20 00 02 29 00];
		qcom,mdss-dsi-off-command = [05 01 00 00 32 00 02 28 00
					05 01 00 00 78 00 02 10 00];
		qcom,mdss-dsi-on-command-state = "dsi_lp_mode";
		qcom,mdss-dsi-off-command-state = "dsi_hs_mode";
		qcom,mdss-dsi-h-sync-pulse = <1>;
		qcom,mdss-dsi-traffic-mode = "burst_mode";
		qcom,mdss-dsi-lane-map = "lane_map_0123";
		qcom,mdss-dsi-bllp-eof-power-mode;
		qcom,mdss-dsi-bllp-power-mode;
		qcom,mdss-dsi-lane-0-state;
		qcom,mdss-dsi-lane-1-state;
		qcom,mdss-dsi-lane-2-state;
		qcom,mdss-dsi-lane-3-state;
		qcom,mdss-dsi-panel-timings = [f9 3d 34 00 58 4d 36 3f 53 03 04 00];
		qcom,mdss-dsi-t-clk-post = <0x42>;
		qcom,mdss-dsi-t-clk-pre = <0x3e>;
		qcom,mdss-dsi-bl-min-level = <1>;
		qcom,mdss-dsi-bl-max-level = <4095>;
		qcom,mdss-dsi-bl-pmic-control-type = "bl_ctrl_pwm";
		qcom,mdss-dsi-bl-pmic-pwm-frequency = <100>;
		qcom,mdss-dsi-bl-pmic-bank-select = <0>;
		qcom,mdss-dsi-pwm-gpio = <&pm8916_mpps 4 0>;
		qcom,mdss-dsi-dma-trigger = "trigger_sw";
		qcom,mdss-dsi-mdp-trigger = "none";
		qcom,mdss-dsi-reset-sequence = <1 20>, <0 10>, <1 20>;
		qcom,mdss-pan-physical-width-dimension = <68>;
		qcom,mdss-pan-physical-height-dimension = <121>;
	};
};
